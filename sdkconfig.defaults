## sdkconfig.defaults
```kconfig
CONFIG_LWIP_IP_FORWARD=y
CONFIG_LWIP_IPV4_NAPT=y
CONFIG_LWIP_L2_TO_L3_COPY=y
CONFIG_ESP_NETIF_NAPT=y
CONFIG_LWIP_MAX_SOCKETS=16
CONFIG_LWIP_DNS_SUPPORT_MDNS_QUERIES=y
```
